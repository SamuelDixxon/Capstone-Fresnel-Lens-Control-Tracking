## Espressif/controls/main/Kconfig.projbuild
```kconfig
menu "Example Configuration"

    config SERIAL_STUDIO_DEBUG
        bool "Enable log that can be parsed by Serial Studio"
        default "n"
        help
            Enable this option, the example will print a string at runtime with a specific format,
            which can be parsed by the Serial Studio tool.
            With the "serial-studio-dashboard.json" template file provided in this example,
            user can observe the speed in a curve window in the Serial Studio.


    config SNTP_TIME_SERVER
        string "SNTP server name"
        default "pool.ntp.org"
        help
            Hostname of the main SNTP server.

    choice SNTP_TIME_SYNC_METHOD
        prompt "Time synchronization method"
        default SNTP_TIME_SYNC_METHOD_IMMED
        help
            Time synchronization method.

        config SNTP_TIME_SYNC_METHOD_IMMED
            bool "update time immediately when received"
        config SNTP_TIME_SYNC_METHOD_SMOOTH
            bool "update time with smooth method (adjtime)"
        config SNTP_TIME_SYNC_METHOD_CUSTOM
            bool "custom implementation"
    endchoice

endmenu
```
